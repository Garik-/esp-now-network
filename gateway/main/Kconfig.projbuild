## gateway/main/Kconfig.projbuild
```kconfig
menu "ESP-NOW Gateway Configuration"
    config ESPNOW_WIFI_SSID
        string "WiFi SSID"
        default "myssid"
        help
            SSID (network name) for the device to connect to.

    config ESPNOW_WIFI_PASSWORD
        string "WiFi Password"
        default "mypassword"
        help
            WiFi password (WPA or WPA2) for the device to use.
            Can be left blank if the network has no security set.

    config ESPNOW_CHANNEL
        int "Channel"
        default 6
        range 0 14
        help
            The channel on which sending and receiving ESPNOW data.

    config ESPNOW_HTTP_PORT
		int "HTTP Server Port"
		default 80
		range 1 65535
		help
			Port number for the HTTP server.

    config ESPNOW_HTTP_AUTH_USER
        string "HTTP Basic Auth User"
        default ""
        help
            Username for Basic Auth on HTTP POST config endpoints.
            Leave blank to disable Basic Auth.

    config ESPNOW_HTTP_AUTH_PASSWORD
        string "HTTP Basic Auth Password"
        default ""
        help
            Password for Basic Auth on HTTP POST config endpoints.
            Leave blank to disable Basic Auth.

	config ESPNOW_MDNS_NAME
		string "mDNS Name"
		default "mydevice"
		help
			Name to register with mDNS.
            
    config ESPNOW_MDNS_INSTANCE_NAME
		string "mDNS Instance Name"
		default "mydevice_instance"
		help
			Instance Name name to register with mDNS.

    config ESPNOW_BROKER_URL
        string "MQTT Broker URL"
        default "mqtt://localhost:1883"
        help
            URL of the MQTT broker to which the gateway will connect.

    config ESPNOW_BROKER_USERNAME
        string "MQTT Broker Username"
        default "mqtt_user"
        help
            Username for authenticating with the MQTT broker.
    config ESPNOW_BROKER_PASSWORD
        string "MQTT Broker Password"
        default "mqtt_password"
        help
            Password for authenticating with the MQTT broker.
endmenu
```
